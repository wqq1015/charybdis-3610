## config/boards/shields/charybdis_nano/Kconfig.defconfig
```kconfig
if SHIELD_CHARYBDIS_NANO_RIGHT

config ZMK_KEYBOARD_NAME
	default "Charybdis_nano"

config ZMK_SPLIT_BLE_ROLE_CENTRAL
	default y

endif

if SHIELD_CHARYBDIS_NANO_LEFT || SHIELD_CHARYBDIS_NANO_RIGHT

config ZMK_SPLIT
	default y
	
endif
```

## config/west.yml
```yaml
manifest:
  remotes:
    - name: zmkfirmware
      url-base: https://github.com/Amos698
  projects:
    - name: zmk
      remote: zmkfirmware
      revision: charybdis-test
      import: app/west.yml
  self:
    path: config
```
